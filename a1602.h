#include<intrins.h>

/*----------------------------------------------------
				lcd1602
----------------------------------------------------*/

sbit RS = P1^6;   //定义端口 ,LCD1602的4脚
sbit RW = P1^5;	//定义端口 ,LCD1602的5脚
sbit EN = P1^4;	//定义端口 ,LCD1602的6脚

#define DataPort P2//定义数据端口 程序中遇到DataPort 则用P0 替换

/*----------------------------------------------------
				lcd1602
----------------------------------------------------*/

/*------------------------------------------------
 uS延时函数，含有输入参数 unsigned char t，无返回值
 unsigned char 是定义无符号字符变量，其值的范围是
 0~255 这里使用晶振12M，精确延时请使用汇编,大致延时
 长度如下 T=tx2+5 uS 
------------------------------------------------*/

void DelayUs2x(unsigned char t){   
 while(--t);
}

/*------------------------------------------------
 mS延时函数，含有输入参数 unsigned char t，无返回值
 unsigned char 是定义无符号字符变量，其值的范围是
 0~255 这里使用晶振12M，精确延时请使用汇编
------------------------------------------------*/

void DelayMs1(unsigned char t){
	while(t--){
    //大致延时1mS
		DelayUs2x(245);
	 	DelayUs2x(245);
    }
}

/*------------------------------------------------
              lcd1602判忙函数
------------------------------------------------*/

bit LCD_Check_Busy(void){ 
	bit result;		//修改了判忙函数
	DataPort= 0xFF; 
	RS=0; 
	RW=1; 
	EN=1; 
	_nop_(); 
	result=(bit)(DataPort & 0x80); 
	EN=0;
	return result;
}
/*------------------------------------------------
              lcd1602写入命令函数
------------------------------------------------*/
void LCD_Write_Com(unsigned char com){  
	while(LCD_Check_Busy()); //忙则等待
	RS=0; 
	RW=0; 
	EN=1; 
	DataPort= com; 
	_nop_(); 
	EN=0;
}

/*------------------------------------------------
              lcd1602写入数据函数
------------------------------------------------*/

void LCD_Write_Data(unsigned char Data) { 
	while(LCD_Check_Busy()); //忙则等待
	RS=1; 
	RW=0; 
	EN=1; 
	DataPort= Data; 
	_nop_();
	EN=0;
}

/*------------------------------------------------
                lcd1602清屏函数
------------------------------------------------*/

void LCD_Clear(void){ 
	LCD_Write_Com(0x01); //写指令
	DelayMs1(5);			//延时，便于执行完成
}

/*------------------------------------------------
              lcd1602写入字符串函数
------------------------------------------------*/

void LCD_Write_String(unsigned char x,unsigned char y,unsigned char *s){ //x代表列，y代表行  
	if(y == 1){ //y==1代表显示在LCD1602第一行    
		LCD_Write_Com(0x80 + x);     //表示第一行
	}
	else{ 		//否则就是第二行，就是必须y==2	      
		LCD_Write_Com(0xC0 + x);      //表示第二行
	}        
	while(*s){     
	 	LCD_Write_Data( *s);     //写入字符
	 	s ++;     			//指向下一个地址
	}
}

/*------------------------------------------------
              光标定位函数
------------------------------------------------*/

void LCD_Pos(unsigned char x,unsigned char y){ //x代表列，y代表行
    
 if(y == 1){ 	//y==1代表显示在LCD1602第一行   
 	LCD_Write_Com(0x80 + x);      //表示第一行
 }    
 else{     
	LCD_Write_Com(0xC0 + x);     //表示第二行
 }          
}

/*------------------------------------------------
              lcd1602初始化函数
------------------------------------------------*/

void LCD_Init(void){
   LCD_Write_Com(0x38);    /*显示模式设置*/ 
   DelayMs1(5); 
   LCD_Write_Com(0x38); 
   DelayMs1(5); 
   LCD_Write_Com(0x38); 
   DelayMs1(5); 
   LCD_Write_Com(0x38);  
   LCD_Write_Com(0x08);    /*显示关闭*/ 
   LCD_Write_Com(0x01);    /*显示清屏*/ 
   LCD_Write_Com(0x06);    /*显示光标移动设置*/ 
   DelayMs1(5); 
   LCD_Write_Com(0x0C);    /*显示开及光标设置*/
}
